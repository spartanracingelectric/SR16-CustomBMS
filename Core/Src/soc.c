#include "soc.h"

#include <math.h>
#include <stdint.h>
#include <stdio.h>

#include "adc.h"
#include "main.h"

void SOC_updateCurrent(batteryModule *batt);

uint16_t SOC_offsetFilter(uint16_t measuredX, uint16_t lowerX, uint16_t upperX,
                          uint16_t lowerY, uint16_t upperY);
uint16_t SOC_searchCapacity(uint16_t data[][2], uint16_t voltage, uint16_t size);

uint16_t SOC_getChargeData0C(uint16_t voltage);
uint16_t SOC_getChargeData25C(uint16_t voltage);
uint16_t SOC_getChargeData40C(uint16_t voltage);

void SOC_getInitialCharge(batteryModule *batt) {
    uint32_t voltage;
    for (int i = 0; i < NUM_CELLS; ++i) {
        voltage += batt->cell_volt[i];
    }
    voltage /= (NUM_DEVICES * 10);

    uint16_t temperature;
    for (int i = 0; i < NUM_THERM_TOTAL; ++i) {
        temperature += batt->cell_temp[i];
    }
    temperature /= NUM_DEVICES;

    int tempCharts[] = {0, 25, 40};

    int minDiff = 100;
    int selectTemp;
    for (int i = 0; i < 3; ++i) {
        if (abs(temperature - tempCharts[i]) < minDiff) {
            minDiff = abs(temperature - tempCharts[i]);
            selectTemp = tempCharts[i];
        }
    }

    switch (selectTemp) {
        case 0:
            batt->soc = SOC_getChargeData0C((uint16_t) voltage) * NUM_DEVICES;
            break;
        case 25:
            batt->soc = SOC_getChargeData25C((uint16_t) voltage) * NUM_DEVICES;
            break;
        default:
            batt->soc = SOC_getChargeData40C((uint16_t) voltage) * NUM_DEVICES;
            break;
    }
}

void SOC_updateCurrent(batteryModule *batt) {
    uint32_t adcValue = 0;
    HAL_ADC_Start(&hadc2);
    if (HAL_ADC_PollForConversion(&hadc2, HAL_MAX_DELAY) == HAL_OK) {
        adcValue = HAL_ADC_GetValue(&hadc2);
    }
    printf("ADC VALUE %u/4096\n", adcValue);
    HAL_ADC_Stop(&hadc2);
    float voltage = ((float)adcValue / ADC_RESOLUTION) * V_REF;
    batt->current = (voltage / (MAX_SHUNT_VOLTAGE * SHUNT_OPAMP_RATIO)) * MAX_SHUNT_AMPAGE + SHUNT_OFFSET;
}

void SOC_updateCharge(batteryModule *batt, uint32_t elapsed_time) {

	HAL_ADCEx_Calibration_Start(&hadc2);
    SOC_updateCurrent(batt);
    batt->soc -= (uint16_t)(batt->current * (float)(elapsed_time / 3600000.0f));
}

uint16_t SOC_searchCapacity(uint16_t data[][2], uint16_t target, uint16_t size) {
    // Get the two closest capacities
    uint16_t left = 0;
    uint16_t right = size - 1;

    if (target >= data[left][0]) {
    	return data[left][1];
    }

    if (target <= data[right][0]) {
    	return data[right][1];
    }

    while (left <= right) {
        int mid = left + (right - left) / 2;

        if (data[mid][0] == target) {
            return data[mid][1];
        }

        if (data[mid][0] > target) {
            left = mid + 1;
        } else {
            right = mid - 1;
        }

        if (left == right - 1) {
        	break;
        }
    }

    return data[right][1];
}

uint16_t SOC_getChargeData0C(uint16_t voltage) {
    int datalen = 202;
    uint16_t data[][2] = {
        {4172, 2924}, {4131, 2910}, {4119, 2896}, {4109, 2882}, {4100, 2868},
        {4093, 2854}, {4087, 2840}, {4082, 2826}, {4077, 2812}, {4073, 2798},
        {4069, 2784}, {4066, 2770}, {4063, 2756}, {4060, 2742}, {4058, 2728},
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        {2517, 130},  {2500, 128}};

    return SOC_searchCapacity(data, voltage, datalen);
}

uint16_t SOC_getChargeData25C(uint16_t voltage) {
    int datalen = 202;
    uint16_t data[][2] = {
        {4178, 2921}, {4156, 2907}, {4145, 2892}, {4134, 2878}, {4126, 2863},
        {4119, 2849}, {4112, 2834}, {4107, 2820}, {4102, 2805}, {4098, 2791},
        {4094, 2776}, {4090, 2762}, {4088, 2747}, {4085, 2733}, {4082, 2718},
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        {2581, 39},   {2500, 24}};

    return SOC_searchCapacity(data, voltage, datalen);
}

uint16_t SOC_getChargeData40C(uint16_t voltage) {
    int datalen = 202;
    uint16_t data[][2] = {
        {4182, 2920}, {4163, 2905}, {4151, 2891}, {4141, 2876}, {4132, 2862},
        {4125, 2847}, {4118, 2833}, {4112, 2818}, {4107, 2804}, {4103, 2789},
        {4099, 2775}, {4096, 2761}, {4093, 2746}, {4089, 2732}, {4087, 2717},
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        {2506, 26},   {2500, 25}};

    return SOC_searchCapacity(data, voltage, datalen);
}

